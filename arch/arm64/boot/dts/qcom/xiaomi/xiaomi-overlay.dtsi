#include "msm-audio-xiaomi.dtsi"
#include "msm-pm660-xiaomi.dtsi"
#include "msm-pm660l-xiaomi.dtsi"
#include "sdm660-audio-xiaomi.dtsi"
#include "sdm660-blsp-xiaomi.dtsi"
#include "sdm660-camera-xiaomi.dtsi"
#include "sdm660-internal-codec-xiaomi.dtsi"
#include "sdm660-mdss-panels-xiaomi.dtsi"
#include "sdm660-mtp-xiaomi.dtsi"
#include "sdm660-pinctrl-xiaomi.dtsi"
#include "sdm660-regulator-xiaomi.dtsi"
#include "sdm660-xiaomi.dtsi"
