#include "../xiaomi-overlay.dtsi"
#include "msm-pm660-wayne.dtsi"
#include "sdm660-camera-sensor-mtp-wayne.dtsi"
#include "sdm660-common-wayne.dtsi"
#include "sdm660-mdss-panels-wayne.dtsi"
#include "sdm660-mtp-wayne.dtsi"
