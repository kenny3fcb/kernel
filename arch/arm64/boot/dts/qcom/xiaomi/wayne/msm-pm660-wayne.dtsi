&pm660_coincell {
	qcom,charge-enable = <0>;
};

&pm660_charger {
	qcom,usb-icl-ua = <2900000>;
	qcom,otg-cl-ua = <1500000>;
	qcom,dc-icl-ua = <2900000>;
	qcom,fcc-max-ua = <2900000>;

	qcom,thermal-mitigation
			= <2900000 2000000 1800000 1500000 1000000 500000 100000>;
};

&pm660_fg {
	qcom,fg-recharge-voltage = <4340>;
};

&pm660_haptics {
	qcom,play-mode = "buffer";
	qcom,vmax-mv = <2204>;
	qcom,wave-shape = "sine";
	qcom,wave-play-rate-us = <4878>;
	qcom,int-pwm-freq-khz = <253>;
	qcom,brake-pattern = <0x2 0x2 0x1 0x0>;
	qcom,wave-samples = <0x3e 0x3e 0x3e 0x0 0x0 0x0 0x0 0x0>;
	qcom,wave-samples-two = <0x3e 0x3e 0x3e 0x3e 0x0 0x0 0x0 0x0>;
	qcom,wave-samples-three = <0x3e 0x3e 0x3e 0x3e 0x3e 0x0 0x0 0x0>;
	qcom,wave-rep-cnt = <1>;
	qcom,wave-samp-rep-cnt = <1>;
	qcom,lra-high-z = "opt1";
	qcom,lra-auto-res-mode = "none";
	qcom,lra-hw-auto-resonance;
};
