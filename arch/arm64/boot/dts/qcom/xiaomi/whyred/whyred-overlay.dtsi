#include "../xiaomi-overlay.dtsi"
#include "msm-pm660-whyred.dtsi"
#include "sdm636-mtp-whyred.dtsi"
#include "sdm636-touchpad-whyred.dsi"
#include "sdm660-camera-sensor-mtp-whyred.dtsi"
#include "sdm660-common-whyred.dtsi"
#include "sdm660-mdss-panels-whyred.dtsi"
#include "sdm660-mtp-whyred.dtsi"
#include "sdm660-whyred.dtsi"
